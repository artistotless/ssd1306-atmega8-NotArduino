/*
* i2cLCD.c
*
* Created: 13.05.2018 12:41:46
* Author : digun
*/

#include <avr/io.h>
#include <stdio.h>
#include <util/delay.h>
#include <stdio.h>
#include <stdlib.h>
#include "twi.h"
#include "LCD_I2C.h"
#include <string.h>






static unsigned char buffer[128*64/8] =
{
	0x00, 0x00, 0x00, 0x00, 0x00, 0x00, 0x00, 0x00,
	0x80, 0xC0, 0xC0, 0xE0, 0xE0, 0x70, 0x70, 0x70,
	0x38, 0x38, 0x38, 0x38, 0x38, 0x38, 0x38, 0x70,
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	0x00, 0x00, 0x00, 0x00, 0x00, 0x00, 0x00, 0x00

};



void delay(short int cnt){
	for (int i =0;i<cnt;i++){
		_delay_ms(1);
	}
}



int main(void)
{
	
	DDRD |= (1<<1);
	
	I2C_Init();
	lcdInit();

	//Установка контрастности - 100 ( макс. 255)
	lcdSendCommand(0x81);
	lcdSendCommand(100);

	lcdClearDisplay();


	//Выбор режима адресации - горизонтальный
	lcdSendCommand(0x20);
	lcdSendCommand(2);

	// Выбор столбца
	//lcdSelectSeg(0,39);
	lcdSelectSeg(10,110);
	
	//Выбор страницы
	//lcdSelectPage(3,7);
	lcdSelectPage(3,3);

	lcdSendCommand(0xA1);
	lcdSendCommand(0xC8);

	//Отправка бит-пикселей

	unsigned char color = 0xFF;
	int smooth = 2;

	//lcdBufferDisplay();

	char strp[11];
	int temp = 0;


	

	lcdTextDisplay("a t m e g a 8");

	lcdSelectPage(5,5);
	lcdSelectSeg(10,110);
	int signal = 1;
	for(int i = 0;i<=18; i++ ){
		lcdSendData(color);
		delay(smooth);
		lcdSendData(color);
		delay(smooth);
		lcdSendData(0);
		lcdSendData(0);
		delay(smooth);

		
		if(i == 17){
			lcdSelectPage(1,1);
			lcdSelectSeg(120,120);
			if(signal==1){
			lcdSendData(0x18);
			signal=0;
			}else{
			lcdSendData(0x00);
			signal=1;
			}
			lcdSelectSeg(10,110);
			
			lcdTextDisplay("Loading: ");
			lcdTextDisplay(strp);
			if(temp < 100){temp++;}
			if(temp>=100){temp=0;}
			sprintf(strp,"%d",temp);
			lcdTextDisplay("%");
			
			i=0;
			if(color == 0xFF){
				PORTD &= (0<<1);
				color = 0x00;
				smooth = 2;
				}else{
				PORTD |= (1<<1);
				color = 0xFF;
				smooth = 2;
			}
			lcdSelectSeg(10,110);
			lcdSelectPage(5,5);
		}
	}


	while(1)
	{

	}
}